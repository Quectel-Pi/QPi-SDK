## kernel/drivers/media/i2c/lt6911uxe_dsi/Kconfig
```kconfig
config CONFIG_VIDEO_LT6911UXE
	tristate "Lontium LT6911UXE HDMI to MIPI DSI firmware driver"
	depends on VIDEO_DEV && I2C
	select FW_LOADER
	help
	  Support firmware loading and upgrade for the LT6911UXE
	  HDMI to MIPI DSI converter.

	  To compile this driver as a module, choose M here: the
	  module will be called lt6911uxe_dsi.
```

## kernel/drivers/net/ethernet/motorcomm/Kconfig
```kconfig
# SPDX-License-Identifier: GPL-2.0-only
#
# Motorcomm device configuration
#

config NET_VENDOR_MOTORCOMM
	bool "Motorcomm devices"
	default y
	depends on PCI
	help
	  If you have a network (Ethernet) card belonging to this class, say Y.

	  Note that the answer to this question doesn't directly affect the
	  kernel: saying N will just cause the configurator to skip all
	  the questions about Motorcomm devices. If you say Y, you will be
	  asked for your specific card in the following questions.

if NET_VENDOR_MOTORCOMM

config YT6801
	tristate "Motorcomm YT6801 PCI Express Gigabit Ethernet support"
	depends on PCI
	select CRC32
	select PHYLIB
	select MOTORCOMM_PHY
	help
	  Say Y here if you have a Motorcomm YT6801 PCI-Express Gigabit
	  Ethernet adapter.

	  To compile this driver as a module, choose M here: the module
	  will be called yt6801.

endif # NET_VENDOR_MOTORCOMM
```

## kernel/drivers/net/wireless/rtl8852be/Kconfig
```kconfig
config RTL8852BE
	tristate "Realtek 8852B PCIE WiFi"
	#depends on PCIE
	default m
```

## kernel/drivers/pcie_mhi/Kconfig
```kconfig
config PCIE_MHI_QUECTEL
	bool "Quectel PCIe MHI driver (V1.3.7)"
	default y
	help
	  Quectel out-of-tree PCIe MHI host driver (V1.3.7).
	  Produces /dev/mhi_QMI0, rmnet_mhi0 etc. for RM520N-GL.
	  This driver's bus type name is "mhi_q"; it does NOT conflict
	  with mainline CONFIG_MHI_BUS (bus name "mhi").
```

## kernel/drivers/qdevinfo/Kconfig
```kconfig
config QDEVINFO_EMMC
    bool "Device Information support"
    help
      Enable Get device information.

config DEVINFO_EMMC
    bool "Get device emmc information"
    depends on QDEVINFO_EMMC
    default y
    help
      If you say yes here you will get support for reading eMMC health,
      capacity, and PMU information through the proc file system.
```
