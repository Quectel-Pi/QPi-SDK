// SPDX-License-Identifier: (GPL-2.0+ OR MIT)

/dts-v1/;

#include "rk3576.dtsi"
#include "rk3576-evb1.dtsi"
#include "rk3576-linux.dtsi"
#include "rk3576-evb1-v12-v31.dtsi"

/ {
	model = "Rockchip RK3576 EVB1 V12_V31 Board";
	compatible = "rockchip,rk3576-evb1-v12-v31", "rockchip,rk3576";
};
